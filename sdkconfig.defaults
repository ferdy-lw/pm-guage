## sdkconfig.defaults
```kconfig
# Rust often needs a bit of an extra main task stack size compared to C (the default is 3K)
#CONFIG_ESP_MAIN_TASK_STACK_SIZE=8000
CONFIG_ESP_MAIN_TASK_STACK_SIZE=15000

# Use this to set FreeRTOS kernel tick frequency to 1000 Hz (100 Hz by default).
# This allows to use 1 ms granularity for thread sleeps (10 ms by default).
CONFIG_FREERTOS_HZ=1000

# Workaround for https://github.com/espressif/esp-idf/issues/7631
#CONFIG_MBEDTLS_CERTIFICATE_BUNDLE=n
#CONFIG_MBEDTLS_CERTIFICATE_BUNDLE_DEFAULT_FULL=n

#CONFIG_LOG_DEFAULT_LEVEL_DEBUG=y
CONFIG_LOG_MAXIMUM_LEVEL_DEBUG=y


CONFIG_IDF_TARGET="esp32s3"
CONFIG_ESP_DEFAULT_CPU_FREQ_MHZ_240=y
CONFIG_ESPTOOLPY_FLASHMODE_QIO=y
CONFIG_ESPTOOLPY_FLASHFREQ_80M=y
CONFIG_ESPTOOLPY_FLASHSIZE_16MB=y
CONFIG_SPIRAM=y
CONFIG_SPIRAM_MODE_OCT=y
CONFIG_IDF_EXPERIMENTAL_FEATURES=y
CONFIG_SPIRAM_SPEED_80M=y
CONFIG_SPIRAM_FETCH_INSTRUCTIONS=y
CONFIG_SPIRAM_RODATA=y
#CONFIG_FREERTOS_HZ=1000
CONFIG_ESP32S3_DATA_CACHE_LINE_64B=y
CONFIG_ESP32S3_DATA_CACHE_LINE_SIZE=64

CONFIG_ESP_CONSOLE_USB_SERIAL_JTAG=n

####
# KConfig
####
CONFIG_EXAMPLE_LCD_RGB_BOUNCE_BUFFER_HEIGHT=10
CONFIG_EXAMPLE_LVGL_PORT_TASK_MAX_DELAY_MS=500
CONFIG_EXAMPLE_LVGL_PORT_TASK_MIN_DELAY_MS=10
CONFIG_EXAMPLE_LVGL_PORT_TASK_PRIORITY=2
CONFIG_EXAMPLE_LVGL_PORT_TASK_STACK_SIZE_KB=6
CONFIG_EXAMPLE_LVGL_PORT_TASK_CORE=1
CONFIG_EXAMPLE_LVGL_PORT_TICK=2

CONFIG_EXAMPLE_LVGL_PORT_AVOID_TEAR_ENABLE=n
#CONFIG_EXAMPLE_LVGL_PORT_AVOID_TEAR_MODE=3
#CONFIG_EXAMPLE_LVGL_PORT_ROTATION_DEGREE=90

##Not tear -> 
CONFIG_EXAMPLE_LVGL_PORT_BUF_PSRAM=y
##CONFIG_EXAMPLE_LVGL_PORT_BUF_INTERNAL=n
##Not tear ->
CONFIG_EXAMPLE_LVGL_PORT_BUF_HEIGHT=100
#
# End KConfig


# - defined in lvgl_port.h CONFIG_EXAMPLE_LCD_TOUCH_CONTROLLER_GT911=y

CONFIG_LV_COLOR_SCREEN_TRANSP=y
CONFIG_LV_MEM_CUSTOM=y
CONFIG_LV_MEMCPY_MEMSET_STD=y
CONFIG_LV_USE_LOG=y
CONFIG_LV_LOG_PRINTF=y
CONFIG_LV_USE_PERF_MONITOR=y
CONFIG_LV_ATTRIBUTE_FAST_MEM_USE_IRAM=y
#CONFIG_LV_FONT_MONTSERRAT_12=y
#CONFIG_LV_FONT_MONTSERRAT_16=y
#CONFIG_LV_FONT_MONTSERRAT_18=y
#CONFIG_LV_FONT_MONTSERRAT_20=y
CONFIG_LV_FONT_MONTSERRAT_22=y
#CONFIG_LV_FONT_MONTSERRAT_24=y
CONFIG_LV_FONT_MONTSERRAT_32=y
CONFIG_LV_FONT_MONTSERRAT_42=y
#CONFIG_LV_FONT_MONTSERRAT_48=y
CONFIG_LV_USE_FONT_COMPRESSED=y
CONFIG_LV_USE_IMGFONT=y
    
#CONFIG_LV_USE_DEMO_WIDGETS=y
#CONFIG_LV_USE_DEMO_BENCHMARK=y
#CONFIG_LV_USE_DEMO_STRESS=y
#CONFIG_LV_USE_DEMO_MUSIC=y
#-does not exist? see CMakeList CONFIG_LV_DEMO_MUSIC_AUTO_PLAY=y
```
